## sources/meta-openrailcon/conf/layer.conf
```bitbake
# We have a conf and classes directory, append to BBPATH
BBPATH .= ":${LAYERDIR}"

# We have a recipes directory containing .bb and .bbappend files, add to BBFILES
BBFILES += "${LAYERDIR}/recipes*/*/*.bb \
            ${LAYERDIR}/recipes*/*/*.bbappend"

BBFILE_COLLECTIONS += "openrailcon"
BBFILE_PATTERN_openrailcon := "^${LAYERDIR}/"
BBFILE_PRIORITY_openrailcon = "99"

LAYERSERIES_COMPAT_openrailcon = "kirkstone"
LAYERDEPENDS_openrailcon = "core"
```
